## build/conf/bblayers.conf
```bitbake
# POKY_BBLAYERS_CONF_VERSION is increased each time build/conf/bblayers.conf
# changes incompatibly
POKY_BBLAYERS_CONF_VERSION = "2"

BBPATH = "${TOPDIR}"
BBFILES ?= ""

BBLAYERS ?= " \
  /home/thomas/Desktop/yocto/poky/meta \
  /home/thomas/Desktop/yocto/poky/meta-poky \
  /home/thomas/Desktop/yocto/poky/meta-yocto-bsp \
  /home/thomas/Desktop/yocto/poky/meta-devlinux \
  /home/thomas/Desktop/yocto/poky/meta-raspberrypi \
  /home/thomas/Desktop/yocto/poky/meta-openembedded/meta-oe \
  "
```
